## conf/bblayers.conf
```bitbake
# LAYER_CONF_VERSION is increased each time build/conf/bblayers.conf
# changes incompatibly
LCONF_VERSION = "6"

BBPATH = "${TOPDIR}"
BBFILES ?= ""

BBLAYERS ?= " \
  /home/sdw-lap-linux/poky/meta \
  /home/sdw-lap-linux/poky/meta-ti \
  /home/sdw-lap-linux/poky/meta-am335xsk-bsp \
  /home/sdw-lap-linux/poky/meta-yocto \
  /home/sdw-lap-linux/poky/meta-yocto-bsp \
  /home/sdw-lap-linux/poky/oe/meta-xfce \
  /home/sdw-lap-linux/poky/oe/meta-gnome \
  /home/sdw-lap-linux/poky/oe/meta-oe \
  "

BBLAYERS_NON_REMOVABLE ?= " \
  /home/sdw-lap-linux/poky/meta \
  /home/sdw-lap-linux/poky/meta-am335xsk-bsp \
  "
```
